## configs/nrf52-generic/Kconfig
```kconfig
#
# For a description of the syntax of this configuration file,
# see the file kconfig-language.txt in the NuttX tools repository.
#

if ARCH_BOARD_NRF52_GENERIC

config NRF52_GENERIC_UART0_RX_PIN
	int "Pin select for UART0 TXD"
	default 23
	---help---
		Pin select for UART0 TXD

config NRF52_GENERIC_UART0_TX_PIN
	int "Pin select for UART0 TXD"
	default 24
	---help---
		Pin select for UART0 TXD

endif
```
